## esp32_firmware/sdkconfig.defaults
```kconfig
# Target: ESP32-C3 Super Mini
# BLE 5.0 only — Classic BT (BR/EDR) is NOT available on C3

CONFIG_PARTITION_TABLE_SINGLE_APP=y

# BLE stack (NimBLE is lighter than Bluedroid on C3)
CONFIG_BT_ENABLED=y
CONFIG_BT_NIMBLE_ENABLED=y
CONFIG_BT_NIMBLE_ROLE_CENTRAL=y
CONFIG_BT_NIMBLE_ROLE_OBSERVER=y

# Wi-Fi
CONFIG_ESP_WIFI_STATIC_RX_BUFFER_NUM=10
CONFIG_ESP_WIFI_DYNAMIC_RX_BUFFER_NUM=32

# Log level
CONFIG_LOG_DEFAULT_LEVEL_INFO=y

# Stack size
CONFIG_ESP_MAIN_TASK_STACK_SIZE=8192
```
